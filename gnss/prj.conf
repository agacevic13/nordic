## CMakeLists.txt
```
#
# Copyright (c) 2019 Nordic Semiconductor
#
# SPDX-License-Identifier: LicenseRef-Nordic-5-Clause
#

cmake_minimum_required(VERSION 3.20.0)

find_package(Zephyr REQUIRED HINTS $ENV{ZEPHYR_BASE})
project(gnss_sample)

zephyr_library_sources(src/main.c
                        src/gps.c 
                        src/cmds.c)

target_include_directories(app PRIVATE src)
        

zephyr_library_sources_ifdef(CONFIG_GNSS_SAMPLE_ASSISTANCE_NRF_CLOUD src/assistance.c)
zephyr_library_sources_ifdef(CONFIG_GNSS_SAMPLE_ASSISTANCE_SUPL src/assistance_supl.c)
zephyr_library_sources_ifdef(CONFIG_GNSS_SAMPLE_ASSISTANCE_MINIMAL src/assistance_minimal.c)
zephyr_library_sources_ifdef(CONFIG_GNSS_SAMPLE_ASSISTANCE_MINIMAL src/mcc_location_table.c)
```

## Kconfig
```
menu "GNSS sample"

choice
	default GNSS_SAMPLE_MODE_PERIODIC
	prompt "Select GNSS operation mode"

config GNSS_SAMPLE_MODE_PERIODIC
	bool "Periodic fixes"

endchoice
endmenu

choice
	default GNSS_SAMPLE_ASSISTANCE_NONE
	prompt "Select whether GNSS assistance is used or not"

config GNSS_SAMPLE_ASSISTANCE_NONE
	bool "Assistance not used"

endchoice

config GNSS_SAMPLE_LOW_ACCURACY
	bool "Allow low accuracy fixes"
	help
	  Allows fixes with lower accuracy.

menu "Zephyr Kernel"
source "Kconfig.zephyr"
endmenu

module = GNSS_SAMPLE
module-str = GNSS sample
source "${ZEPHYR_BASE}/subsys/logging/Kconfig.template.log_config"
```

## prj.conf
```kconfig
# General
CONFIG_FPU=y
CONFIG_NRF_MODEM_LIB=y
# CONFIG_STDOUT_CONSOLE=y
CONFIG_UART_INTERRUPT_DRIVEN=y
CONFIG_PICOLIBC_IO_FLOAT=y
CONFIG_LOG=y
# CONFIG_LOG_MODE_IMMEDIATE=y


# GNSS sample
CONFIG_GNSS_SAMPLE_MODE_PERIODIC=y
CONFIG_GNSS_SAMPLE_LOW_ACCURACY=y
CONFIG_GNSS_SAMPLE_ASSISTANCE_NONE=y

# LTE Link Control
CONFIG_LTE_LINK_CONTROL=y

#low level functions that is a standard for all OS
CONFIG_POSIX_API=y

# AT Host library - Used to send AT commands directy from an UART terminal and to allow
#		    integration with nRF Connect for Desktop LTE Link monitor application.
CONFIG_AT_HOST_LIBRARY=y

# Disable native network stack to save some memory
CONFIG_NET_NATIVE=n

# Memory and stack configuration
CONFIG_HEAP_MEM_POOL_SIZE=16000
CONFIG_MAIN_STACK_SIZE=16000
CONFIG_SYSTEM_WORKQUEUE_STACK_SIZE=16000

CONFIG_BOOT_BANNER=n
CONFIG_MAIN_THREAD_PRIORITY=5
CONFIG_ZBUS=y
CONFIG_ZBUS_LOG_LEVEL_INF=y
CONFIG_ZBUS_CHANNEL_NAME=y
CONFIG_ZBUS_OBSERVER_NAME=y
CONFIG_ZBUS_RUNTIME_OBSERVERS=y

# CONFIG_LOG_COLORS=y

CONFIG_USE_SEGGER_RTT=y
CONFIG_SHELL_BACKEND_RTT=y

CONFIG_SHELL=y
CONFIG_SHELL_LOG_BACKEND=y
CONFIG_LOG_CMDS=y
CONFIG_LOG_BACKEND_RTT=y
CONFIG_LOG_BACKEND_RTT_BUFFER=2


# CONFIG_PRINTK=y
# CONFIG_SHELL=y
# CONFIG_LOG_CMDS=y
# CONFIG_MCUMGR_GRP_SHELL=y
# CONFIG_UART_CONSOLE_MCUMGR=y

CONFIG_INIT_STACKS=y
CONFIG_THREAD_STACK_INFO=y
CONFIG_KERNEL_SHELL=y
CONFIG_THREAD_MONITOR=y
CONFIG_THREAD_NAME=y
CONFIG_DEVICE_SHELL=y
CONFIG_POSIX_CLOCK=y
CONFIG_DATE_SHELL=y
CONFIG_THREAD_RUNTIME_STATS=y
CONFIG_THREAD_RUNTIME_STATS_USE_TIMING_FUNCTIONS=y
CONFIG_STATS=y
CONFIG_STATS_SHELL=y

CONFIG_DEBUG_THREAD_INFO=y
CONFIG_FAULT_DUMP=2
CONFIG_PRINTK=y
CONFIG_LOG=y

CONFIG_SHELL_BACKEND_RTT_LOG_MESSAGE_QUEUE_SIZE=1024
CONFIG_SHELL_STACK_SIZE=4096
```

## src/main.c
```c
#include <stdlib.h>
#include <string.h>
#include <math.h>
#include <zephyr/kernel.h>
#include <zephyr/logging/log.h>
#include <nrf_modem_at.h>
#include <nrf_modem_gnss.h>
#include <modem/lte_lc.h>
#include <modem/nrf_modem_lib.h>

#include <gps.h>

void main(void)
{
    modem_lib_initialize();

    gps_start();

    while(1)
    {
        
        k_msleep(10000);   
    }
}
```

## src/cmds.c
```c
#include <zephyr/kernel.h>
#include <zephyr/shell/shell.h>
#include <zephyr/sys/reboot.h>
#include <stdlib.h>

#include <zephyr/logging/log.h>
#include <gps.h>
LOG_MODULE_REGISTER(cmds);

extern bool isGpsActive;

static int reset(const struct shell *sh, size_t argc, char **argv) {
	//sys_reboot(SYS_REBOOT_COLD);
	return 0;
}

static int get_position_cmd(const struct shell *sh, size_t argc, char **argv) {
	LOG_INF("requesting a single fix");
	LOG_INF("gps Active = %d", isGpsActive);
	if(isGpsActive == false)
	{
		get_position();
	}
	else if(isGpsActive == true)
	{
		LOG_WRN("GPS already searching!");
		return 0;
	}
	return 0;
}

static int set_nwkId(const struct shell *sh, size_t argc, char **argv) {
	if (argc != 2 && argc != 1) {
		LOG_ERR("Invalid nwk id command...");
		return -1;
	}

	char nwk_id[5];
	nwk_id[4] = 0;
	// PawrBroadcaster_GetNwkId(nwk_id, 4);
	LOG_INF("Current nwk id: %s", nwk_id);

	if (argc == 1) {
		return 0;
	}

	LOG_INF("Requested nwk id: %s, len: %d", argv[1], strlen(argv[1]));
	// PawrBroadcaster_SetNwkId(argv[1], strlen(argv[1]));

	// PawrBroadcaster_GetNwkId(nwk_id, 4);
	LOG_INF("New nwk id: %s", nwk_id);

	return 0;
}

static int set_version(const struct shell *sh, size_t argc, char **argv) {
	if (argc != 2 && argc != 1) {
		LOG_ERR("Invalid nwk id command...");
		return -1;
	}

	char version[16];
	version[15] = 0;
	// PawrBroadcaster_GetVersion(version, sizeof(version));
	LOG_INF("Current version: %s", version);

	if (argc == 1) {
		return 0;
	}

	LOG_INF("Requested version: %s, len: %d", argv[1], strlen(argv[1]));
	// PawrBroadcaster_SetVersion(argv[1], strlen(argv[1]));

	// PawrBroadcaster_GetVersion(version, sizeof(version));
	LOG_INF("New version: %s", version);

	return 0;
}

static int set_phy(const struct shell *sh, size_t argc, char **argv) {
	if (argc == 1) {
		LOG_INF("Current phy: %s", true ? "coded" : "1m");
		return 0;
	}
	else if (argc != 2) {
		LOG_ERR("Invalid version command...");
	}

	LOG_INF("Current phy: %s", true ? "coded" : "1m");
	LOG_INF("Requested phy: %s", atoi(argv[1]) == 1 ? "coded" : "1m");
	// PawrBroadcaster_SetPhy(atoi(argv[1]));
	LOG_INF("New phy: %s", true ? "coded" : "1m");

	return 0;
}

static int set_pollRate(const struct shell *sh, size_t argc, char **argv) {
	if (argc != 2) {
		LOG_ERR("Invalid arguments");
		return -EINVAL;
	}

    // Convert strings to integers using atoi
    uint16_t pollRate = (uint16_t)atoi(argv[1]);
	// PawrBroadcaster_SetPollingRate(pollRate);
	return 0;
}

static int set_params(const struct shell *sh, size_t argc, char **argv) {
	if (argc != 5) {
		LOG_ERR("Invalid arguments");
		return -EINVAL;
	}

    // Convert strings to integers using atoi
    uint8_t subeventInterval = (uint8_t)atoi(argv[1]);
    uint8_t rspSlotDelay = (uint8_t)atoi(argv[2]);
    uint8_t rspSlotSpacing = (uint8_t)atoi(argv[3]);
    uint8_t nRspSlots = (uint8_t)atoi(argv[4]);

	// PawrBroadcaster_SetPawrParams(subeventInterval, rspSlotDelay, rspSlotSpacing, nRspSlots);
	return 0;
}

static int set_timeout(const struct shell *sh, size_t argc, char **argv) {
	if (argc != 2) {
		LOG_ERR("Invalid arguments");
		return -EINVAL;
	}

    // Convert strings to integers using atoi
    uint32_t timeout = (uint16_t)atoi(argv[1]);
	// PawrBroadcaster_SetSlotTimeoutInSeconds(timeout);
	return 0;
}

SHELL_CMD_REGISTER(reset, NULL, "Reset the chip", reset);
SHELL_CMD_REGISTER(get_position, NULL, "Start broadcaster", get_position_cmd);
SHELL_CMD_REGISTER(nwkid, NULL, "Set nwk_id. Requires 2 arguments, argv[1] length must be 4. Default value: 1234.", set_nwkId);
SHELL_CMD_REGISTER(version, NULL, "Modifies version of the broadcaster. Example: ", set_version);
SHELL_CMD_REGISTER(phy, NULL, "Modifies phy of the broadcaster. Example: ", set_phy);
SHELL_CMD_REGISTER(pollRate, NULL, "Set poll rate. Example: ", set_pollRate);
SHELL_CMD_REGISTER(params, NULL, "Modifies adv parameters. Example: ", set_params);
SHELL_CMD_REGISTER(timeout, NULL, "Modifies adv parameters. Example: ", set_timeout);
```

## src/gps.c
```c
#include <stdio.h>
#include <stdlib.h>
#include <string.h>
#include <math.h>
#include <zephyr/kernel.h>
#include <zephyr/logging/log.h>
#include <nrf_modem_at.h>
#include <nrf_modem_gnss.h>
#include <modem/lte_lc.h>
#include <modem/nrf_modem_lib.h>

#include <gps.h>

LOG_MODULE_REGISTER(gnss_sample, CONFIG_GNSS_SAMPLE_LOG_LEVEL);

bool isGpsActive = true;
static const char update_indicator[] = {'\\', '|', '/', '-'};

static struct nrf_modem_gnss_pvt_data_frame last_pvt;
// static uint64_t fix_timestamp;


/* Reference position. */
static bool ref_used;
static double ref_latitude;
static double ref_longitude;

static K_SEM_DEFINE(pvt_data_sem, 0, 1);

static struct k_poll_event events[1] = {
	K_POLL_EVENT_STATIC_INITIALIZER(K_POLL_TYPE_SEM_AVAILABLE,
					K_POLL_MODE_NOTIFY_ONLY,
					&pvt_data_sem, 0),
};

/* Returns the distance between two coordinates in meters. The distance is calculated using the
 * haversine formula.*/
static double distance_calculate(double lat1, double lon1, double lat2, double lon2)
{
	double d_lat_rad = (lat2 - lat1) * PI / 180.0;
	double d_lon_rad = (lon2 - lon1) * PI / 180.0;

	double lat1_rad = lat1 * PI / 180.0;
	double lat2_rad = lat2 * PI / 180.0;

	double a = pow(sin(d_lat_rad / 2), 2) +
		   pow(sin(d_lon_rad / 2), 2) *
		   cos(lat1_rad) * cos(lat2_rad);

	double c = 2 * asin(sqrt(a));

	return EARTH_RADIUS_METERS * c;
}

static void print_distance_from_reference(struct nrf_modem_gnss_pvt_data_frame *pvt_data)
{
	if (!ref_used) 
	{
		return;
	}
	double distance = distance_calculate(pvt_data->latitude, pvt_data->longitude, ref_latitude, ref_longitude);
	LOG_INF("\nDistance from reference: %.01f\n", distance);
}

void gnss_event_handler(int event)
{
	int retval;

	switch (event) {
	case NRF_MODEM_GNSS_EVT_PVT:
		retval = nrf_modem_gnss_read(&last_pvt, sizeof(last_pvt), NRF_MODEM_GNSS_DATA_PVT);
		if (retval == 0) {
			k_sem_give(&pvt_data_sem);
		}
		 if (last_pvt.flags & NRF_MODEM_GNSS_PVT_FLAG_FIX_VALID) {
            isGpsActive = false;
        }
        break;
	case NRF_MODEM_GNSS_EVT_SLEEP_AFTER_TIMEOUT:
		isGpsActive = false;
		LOG_INF("gps Active = %d", isGpsActive);
		k_sem_give(&pvt_data_sem);
		LOG_INF("line 79");
		LOG_WRN("Deadling missed");
		LOG_INF("gps Active = %d", isGpsActive);
		break;
	case NRF_MODEM_GNSS_EVT_PERIODIC_WAKEUP:
		isGpsActive = true;
		LOG_INF("line 83");
		LOG_INF("gps Active = %d", isGpsActive);
		LOG_WRN("GPS searching");
		break;
	case NRF_MODEM_GNSS_EVT_SLEEP_AFTER_FIX:
		isGpsActive = false;
		k_sem_give(&pvt_data_sem);
		LOG_INF("line 89");
		LOG_WRN("GPS sleeping after fix");
		break;
	}
	
}
static int periodic_gnss_init(void)
{
#if defined(CONFIG_GNSS_SAMPLE_ASSISTANCE_NONE) || defined(CONFIG_GNSS_SAMPLE_LTE_ON_DEMAND)
	/* Enable GNSS. */
	if (lte_lc_func_mode_set(LTE_LC_FUNC_MODE_ACTIVATE_GNSS) != 0) {
		LOG_ERR("Failed to activate GNSS functional mode");
		return -1;
	}
#endif /* CONFIG_GNSS_SAMPLE_ASSISTANCE_NONE || CONFIG_GNSS_SAMPLE_LTE_ON_DEMAND */

	/* Configure GNSS. */
	if (nrf_modem_gnss_event_handler_set(gnss_event_handler) != 0) {
		LOG_ERR("Failed to set GNSS event handler");
		return -1;
	}
	/* This use case flag should always be set. */
	uint8_t use_case = NRF_MODEM_GNSS_USE_CASE_MULTIPLE_HOT_START;

	if (IS_ENABLED(CONFIG_GNSS_SAMPLE_LOW_ACCURACY)) {
		use_case |= NRF_MODEM_GNSS_USE_CASE_LOW_ACCURACY;
	}

	if (nrf_modem_gnss_use_case_set(use_case) != 0) {
		LOG_WRN("Failed to set GNSS use case");
	}
	/* FOR PERIODIC TRACKING */
	uint16_t fix_retry = GNSS_SAMPLE_PERIODIC_TIMEOUT;
	uint16_t fix_interval = GNSS_SAMPLE_PERIODIC_INTERVAL;

	if (nrf_modem_gnss_fix_retry_set(fix_retry) != 0) {
		LOG_ERR("Failed to set GNSS fix retry");
		return -1;
	}

	if (nrf_modem_gnss_fix_interval_set(fix_interval) != 0) {
		LOG_ERR("Failed to set GNSS fix interval");
		return -1;
	}

	if (nrf_modem_gnss_start() != 0) {
		LOG_ERR("Failed to start GNSS");
		return -1;
	}

	return 0;
}

static void print_satellite_stats(struct nrf_modem_gnss_pvt_data_frame *pvt_data)
{
	uint8_t tracked   = 0;
	uint8_t in_fix    = 0;
	uint8_t unhealthy = 0;

	for (int i = 0; i < NRF_MODEM_GNSS_MAX_SATELLITES; ++i) {
		if (pvt_data->sv[i].sv > 0) {
			tracked++;

			if (pvt_data->sv[i].flags & NRF_MODEM_GNSS_SV_FLAG_USED_IN_FIX) {
				in_fix++;
			}

			if (pvt_data->sv[i].flags & NRF_MODEM_GNSS_SV_FLAG_UNHEALTHY) {
				unhealthy++;
			}
		}
	}

	LOG_INF("Tracking: %2d Using: %2d Unhealthy: %d\n", tracked, in_fix, unhealthy);
}

static void print_fix_data(struct nrf_modem_gnss_pvt_data_frame *pvt_data)
{
	LOG_INF("Latitude:       %.06f\n", pvt_data->latitude);
	LOG_INF("Longitude:      %.06f\n", pvt_data->longitude);
	LOG_INF("Altitude:       %.01f m\n", (double)pvt_data->altitude);
	LOG_INF("Accuracy:       %.01f m\n", (double)pvt_data->accuracy);
	LOG_INF("Speed:          %.01f m/s\n", (double)pvt_data->speed);
	LOG_INF("Speed accuracy: %.01f m/s\n", (double)pvt_data->speed_accuracy);
	LOG_INF("Heading:        %.01f deg\n", (double)pvt_data->heading);
	LOG_INF("Date:           %04u-%02u-%02u\n",
	       pvt_data->datetime.year,
	       pvt_data->datetime.month,
	       pvt_data->datetime.day);
	LOG_INF("Time (UTC):     %02u:%02u:%02u.%03u\n",
	       pvt_data->datetime.hour,
	       pvt_data->datetime.minute,
	       pvt_data->datetime.seconds,
	       pvt_data->datetime.ms);
	LOG_INF("PDOP:           %.01f\n", (double)pvt_data->pdop);
	LOG_INF("HDOP:           %.01f\n", (double)pvt_data->hdop);
	LOG_INF("VDOP:           %.01f\n", (double)pvt_data->vdop);
	LOG_INF("TDOP:           %.01f\n", (double)pvt_data->tdop);
}
void modem_lib_initialize(void)
{
	int err;

	err = nrf_modem_lib_init();
	if (err) {
		LOG_ERR("Modem library initialization failed, error: %d", err);
		return err;
	}

}

int gps_start(void)
{
	uint8_t cnt = 0;
	static uint64_t fix_timestamp;
	LOG_INF("Starting periodic GNSS sample");

	if (periodic_gnss_init() != 0) 
	{
		LOG_ERR("Failed to initialize and start periodic GNSS");
		return -1;
	}
	isGpsActive = true;
	fix_timestamp = k_uptime_get();
	
	LOG_INF("gps Active = %d", isGpsActive);
	for (;;) {
		(void)k_poll(events, 1, K_FOREVER);
		

		if (events[0].state == K_POLL_STATE_SEM_AVAILABLE &&
		    k_sem_take(events[0].sem, K_NO_WAIT) == 0) {

			/* PVT and NMEA output mode. */
			// LOG_INF("\033[1;1H");
			// LOG_INF("\033[2J");
			print_satellite_stats(&last_pvt);

			if (last_pvt.flags & NRF_MODEM_GNSS_PVT_FLAG_DEADLINE_MISSED) {
				LOG_INF("GNSS operation blocked by LTE\n");
			}
			if (last_pvt.flags &
				NRF_MODEM_GNSS_PVT_FLAG_NOT_ENOUGH_WINDOW_TIME) {
				LOG_INF("Insufficient GNSS time windows\n");
			}
			if (last_pvt.flags & NRF_MODEM_GNSS_PVT_FLAG_SLEEP_BETWEEN_PVT) {
				LOG_INF("Sleep period(s) between PVT notifications\n");
			}
			LOG_INF("-----------------------------------\n");

			if (last_pvt.flags & NRF_MODEM_GNSS_PVT_FLAG_FIX_VALID) {
				fix_timestamp = k_uptime_get();
				print_fix_data(&last_pvt);
				print_distance_from_reference(&last_pvt);

			} 
			else 
			{
				LOG_INF("Seconds since last periodic fix: %d\n",
						(uint32_t)((k_uptime_get() - fix_timestamp) / 1000));
				cnt++;
				LOG_INF("Searching [%c]\n", update_indicator[cnt%4]);
			}	
		}
	}
	return 0;
}


static int single_fix_gnss_init_and_start(void)
{
#if defined(CONFIG_GNSS_SAMPLE_ASSISTANCE_NONE) || defined(CONFIG_GNSS_SAMPLE_LTE_ON_DEMAND)
	/* Enable GNSS. */
	if (lte_lc_func_mode_set(LTE_LC_FUNC_MODE_ACTIVATE_GNSS) != 0) {
		LOG_ERR("Failed to activate GNSS functional mode");
		return -1;
	}
#endif /* CONFIG_GNSS_SAMPLE_ASSISTANCE_NONE || CONFIG_GNSS_SAMPLE_LTE_ON_DEMAND */

	/* Configure GNSS. */
	if (nrf_modem_gnss_event_handler_set(gnss_event_handler) != 0) {
		LOG_ERR("Failed to set GNSS event handler");
		return -1;
	}
	/* This use case flag should always be set. */
	uint8_t use_case = NRF_MODEM_GNSS_USE_CASE_MULTIPLE_HOT_START;

	if (IS_ENABLED(CONFIG_GNSS_SAMPLE_LOW_ACCURACY)) {
		use_case |= NRF_MODEM_GNSS_USE_CASE_LOW_ACCURACY;
	}

	if (nrf_modem_gnss_use_case_set(use_case) != 0) {
		LOG_WRN("Failed to set GNSS use case");
	}
	/* FOR single FIX */
	// uint16_t fix_retry = SINGLE_FIX_TIMEOUT_SEC;
	// uint16_t fix_interval = 0;

	if (nrf_modem_gnss_fix_retry_set(SINGLE_FIX_TIMEOUT_SEC) != 0) {
		LOG_ERR("Failed to set GNSS fix retry");
		return -1;
	}

	if (nrf_modem_gnss_fix_interval_set(SINGLE_FIX_INTERVAL) != 0) {
		LOG_ERR("Failed to set GNSS fix interval");
		return -1;
	}

	if (nrf_modem_gnss_start() != 0) {
		LOG_ERR("Failed to start GNSS");
		return -1;
	}

	return 0;
}

int get_position(void)
{
	int err; 
	static uint64_t fix_timestamp;
	uint8_t cnt = 0;
	//stop periodic gnss
	
	LOG_WRN("Stopping periodic gps");
	err = nrf_modem_gnss_stop();
	if (err) 
	{
		LOG_ERR("Stopping periodic gnss failed, error: %d", err);
		return err;
	}
	k_msleep(3000);

	LOG_INF("initialize single fix");
	
	if (single_fix_gnss_init_and_start() != 0) {
		LOG_ERR("Failed to initialize and start GNSS");
		return -1;
	}
	k_msleep(1000);
	isGpsActive = true;
	LOG_INF("get to 309");
	while (1) 
	{
		(void)k_poll(events, 1, K_FOREVER);

		if(events[0].state == K_POLL_STATE_SEM_AVAILABLE && k_sem_take(events[0].sem, K_NO_WAIT) == 0)
		{
			// LOG_INF("\033[1;1H");
			// LOG_INF("\033[2J");
			print_satellite_stats(&last_pvt);
		
			if (last_pvt.flags & NRF_MODEM_GNSS_PVT_FLAG_DEADLINE_MISSED) 
			{
				LOG_INF("GNSS operation blocked by LTE\n");
			}
			if (last_pvt.flags & NRF_MODEM_GNSS_PVT_FLAG_NOT_ENOUGH_WINDOW_TIME) 
			{
				LOG_INF("Insufficient GNSS time windows\n");
			}
			if (last_pvt.flags & NRF_MODEM_GNSS_PVT_FLAG_SLEEP_BETWEEN_PVT) 
			{
				LOG_INF("Sleep period(s) between PVT notifications\n");
			}
	
			LOG_INF("-----------------------------------\n");

			if (last_pvt.flags & NRF_MODEM_GNSS_PVT_FLAG_FIX_VALID) 
			{
				
				fix_timestamp = k_uptime_get();
		
				print_fix_data(&last_pvt);
				print_distance_from_reference(&last_pvt);

				LOG_WRN("354 get here");		
				// k_mutex_lock(&last_pvt_mutex, K_FOREVER);
				// zbus_chan_pub(&acc_data_channel, &last_pvt, K_SECONDS(1));
				// k_mutex_unlock(&last_pvt_mutex);
				
				break;
			}
			else 
			{
				LOG_INF("Seconds since last single fix: %d\n",
						(uint32_t)((k_uptime_get() - fix_timestamp) / 1000));
				cnt++;
				LOG_INF("Searching [%c]\n", update_indicator[cnt%4]);
			}
		}
		LOG_INF("looping...");
		 k_msleep(2000);
	}
	LOG_WRN("get here 372");
	k_sem_give(&pvt_data_sem);
	k_msleep(3000);
	err = nrf_modem_gnss_stop();
	if (err) {
		LOG_INF("Failed to stop GNSS, error %d\n",err);
	}
	LOG_INF("Stopped single fix GNSS");
	k_msleep(1000);
	LOG_INF("Starting periodic GNSS");
	err = gps_start();
	if(err)
	{
		LOG_INF("Failed to initialize periodic GNSS, error: %d\n", err);
	}

	return 0;
}
```

## src/gps.h
```c
#include <stdio.h>
#include <string.h>
#include <math.h>
#include <zephyr/kernel.h>
#include <zephyr/logging/log.h>
#include <nrf_modem_at.h>
#include <nrf_modem_gnss.h>
#include <modem/lte_lc.h>
#include <modem/nrf_modem_lib.h>


#define GNSS_SAMPLE_PERIODIC_INTERVAL	120
#define GNSS_SAMPLE_PERIODIC_TIMEOUT	70
#define PI 3.14159265358979323846
#define EARTH_RADIUS_METERS (6371.0 * 1000.0)
#define SINGLE_FIX_TIMEOUT_SEC 10
#define SINGLE_FIX_INTERVAL		0

void modem_lib_initialize(void);
int gps_start(void);
int get_position(void);
```

## src/main1.c
```c
#include <stdio.h>
#include <stdlib.h>
#include <string.h>
#include <math.h>
#include <zephyr/kernel.h>
#include <zephyr/logging/log.h>
#include <modem/nrf_modem_lib.h>
#include <nrf_modem_at.h>
#include <nrf_modem_gnss.h>
#include <modem/lte_lc.h>
#include <stdint.h>
#include <zephyr/zbus/zbus.h>

//LOG_MODULE_DECLARE(zbus, CONFIG_ZBUS_LOG_LEVEL);

LOG_MODULE_REGISTER(gnss_sample, CONFIG_GNSS_SAMPLE_LOG_LEVEL);

#define GNSS_SAMPLE_PERIODIC_INTERVAL	120
#define GNSS_SAMPLE_PERIODIC_TIMEOUT	120
#define PI 3.14159265358979323846
#define EARTH_RADIUS_METERS (6371.0 * 1000.0)

struct nrf_modem_gnss_pvt_data_frame *pvt_data;

K_MUTEX_DEFINE(last_pvt_mutex);

static const char update_indicator[] = {'\\', '|', '/', '-'};

static struct nrf_modem_gnss_pvt_data_frame last_pvt;
static uint64_t fix_timestamp;

/* Reference position. */
static bool ref_used;
static double ref_latitude;
static double ref_longitude;

static K_SEM_DEFINE(pvt_data_sem, 0, 1);

static struct k_poll_event events[1] = {
	K_POLL_EVENT_STATIC_INITIALIZER(K_POLL_TYPE_SEM_AVAILABLE,
					K_POLL_MODE_NOTIFY_ONLY,
					&pvt_data_sem, 0),
};

//define channel
ZBUS_CHAN_DEFINE(acc_data_channel,
                struct nrf_modem_gnss_pvt_data_frame,
                NULL,
                NULL,
                ZBUS_OBSERVERS(bar_sub),
                ZBUS_MSG_INIT(0)
);
//define subscriber
ZBUS_SUBSCRIBER_DEFINE(bar_sub, 4);
//define subscriber task
static void subscriber_task(void)
{
    const struct zbus_channel *chan;

    while(!zbus_sub_wait(&bar_sub, &chan, K_FOREVER))
    {
        struct nrf_modem_gnss_pvt_data_frame *pvt_data = &last_pvt;

        if(&acc_data_channel == chan)
        {
            k_mutex_lock(&last_pvt_mutex, K_FOREVER);
            zbus_chan_read(&acc_data_channel, &last_pvt, K_MSEC(500));

            LOG_INF("From subscriber -> Latitude: %0.06f, Longitude: %0.06f, Altitude: %0.01f", pvt_data->latitude, pvt_data->longitude, pvt_data->altitude);

            k_mutex_unlock(&last_pvt_mutex);
        }
    }
}

K_THREAD_DEFINE(subscriber_task_id, CONFIG_MAIN_STACK_SIZE, subscriber_task, NULL, NULL, NULL, 3, 0, 0);


/* Returns the distance between two coordinates in meters. The distance is calculated using the
 * haversine formula.*/
static double distance_calculate(double lat1, double lon1, double lat2, double lon2)
{
	double d_lat_rad = (lat2 - lat1) * PI / 180.0;
	double d_lon_rad = (lon2 - lon1) * PI / 180.0;

	double lat1_rad = lat1 * PI / 180.0;
	double lat2_rad = lat2 * PI / 180.0;

	double a = pow(sin(d_lat_rad / 2), 2) +
		   pow(sin(d_lon_rad / 2), 2) *
		   cos(lat1_rad) * cos(lat2_rad);

	double c = 2 * asin(sqrt(a));

	return EARTH_RADIUS_METERS * c;
}

static void print_distance_from_reference(struct nrf_modem_gnss_pvt_data_frame *pvt_data)
{
	if (!ref_used) 
	{
		return;
	}
	double distance = distance_calculate(pvt_data->latitude, pvt_data->longitude, ref_latitude, ref_longitude);
	LOG_INF("\nDistance from reference: %.01f\n", distance);
}

static void gnss_event_handler(int event)
{
	int retval;

	switch (event) {
	case NRF_MODEM_GNSS_EVT_PVT:
		retval = nrf_modem_gnss_read(&last_pvt, sizeof(last_pvt), NRF_MODEM_GNSS_DATA_PVT);
		if (retval == 0) {
			k_sem_give(&pvt_data_sem);
		}
		break;
	default:
		break;
	}
}
static int gnss_init_and_start(void)
{
#if defined(CONFIG_GNSS_SAMPLE_ASSISTANCE_NONE) || defined(CONFIG_GNSS_SAMPLE_LTE_ON_DEMAND)
	/* Enable GNSS. */
	if (lte_lc_func_mode_set(LTE_LC_FUNC_MODE_ACTIVATE_GNSS) != 0) {
		LOG_ERR("Failed to activate GNSS functional mode");
		return -1;
	}
#endif /* CONFIG_GNSS_SAMPLE_ASSISTANCE_NONE || CONFIG_GNSS_SAMPLE_LTE_ON_DEMAND */

	/* Configure GNSS. */
	if (nrf_modem_gnss_event_handler_set(gnss_event_handler) != 0) {
		LOG_ERR("Failed to set GNSS event handler");
		return -1;
	}
	/* This use case flag should always be set. */
	uint8_t use_case = NRF_MODEM_GNSS_USE_CASE_MULTIPLE_HOT_START;

	if (IS_ENABLED(CONFIG_GNSS_SAMPLE_LOW_ACCURACY)) {
		use_case |= NRF_MODEM_GNSS_USE_CASE_LOW_ACCURACY;
	}

	if (nrf_modem_gnss_use_case_set(use_case) != 0) {
		LOG_WRN("Failed to set GNSS use case");
	}
	/* FOR PERIODIC TRACKING */
	uint16_t fix_retry = GNSS_SAMPLE_PERIODIC_TIMEOUT;
	uint16_t fix_interval = GNSS_SAMPLE_PERIODIC_INTERVAL;

	if (nrf_modem_gnss_fix_retry_set(fix_retry) != 0) {
		LOG_ERR("Failed to set GNSS fix retry");
		return -1;
	}

	if (nrf_modem_gnss_fix_interval_set(fix_interval) != 0) {
		LOG_ERR("Failed to set GNSS fix interval");
		return -1;
	}

	if (nrf_modem_gnss_start() != 0) {
		LOG_ERR("Failed to start GNSS");
		return -1;
	}

	return 0;
}

static void print_satellite_stats(struct nrf_modem_gnss_pvt_data_frame *pvt_data)
{
	uint8_t tracked   = 0;
	uint8_t in_fix    = 0;
	uint8_t unhealthy = 0;

	for (int i = 0; i < NRF_MODEM_GNSS_MAX_SATELLITES; ++i) {
		if (pvt_data->sv[i].sv > 0) {
			tracked++;

			if (pvt_data->sv[i].flags & NRF_MODEM_GNSS_SV_FLAG_USED_IN_FIX) {
				in_fix++;
			}

			if (pvt_data->sv[i].flags & NRF_MODEM_GNSS_SV_FLAG_UNHEALTHY) {
				unhealthy++;
			}
		}
	}

	LOG_INF("Tracking: %2d Using: %2d Unhealthy: %d\n", tracked, in_fix, unhealthy);
}

static void print_fix_data(struct nrf_modem_gnss_pvt_data_frame *pvt_data)
{
	LOG_INF("Latitude:       %.06f\n", pvt_data->latitude);
	LOG_INF("Longitude:      %.06f\n", pvt_data->longitude);
	LOG_INF("Altitude:       %.01f m\n", (double)pvt_data->altitude);
	LOG_INF("Accuracy:       %.01f m\n", (double)pvt_data->accuracy);
	LOG_INF("Speed:          %.01f m/s\n", (double)pvt_data->speed);
	LOG_INF("Speed accuracy: %.01f m/s\n", (double)pvt_data->speed_accuracy);
	LOG_INF("Heading:        %.01f deg\n", (double)pvt_data->heading);
	LOG_INF("Date:           %04u-%02u-%02u\n",
	       pvt_data->datetime.year,
	       pvt_data->datetime.month,
	       pvt_data->datetime.day);
	LOG_INF("Time (UTC):     %02u:%02u:%02u.%03u\n",
	       pvt_data->datetime.hour,
	       pvt_data->datetime.minute,
	       pvt_data->datetime.seconds,
	       pvt_data->datetime.ms);
	LOG_INF("PDOP:           %.01f\n", (double)pvt_data->pdop);
	LOG_INF("HDOP:           %.01f\n", (double)pvt_data->hdop);
	LOG_INF("VDOP:           %.01f\n", (double)pvt_data->vdop);
	LOG_INF("TDOP:           %.01f\n", (double)pvt_data->tdop);
}

int main(void)
{
	int err;
	uint8_t cnt = 0;

	LOG_INF("Starting GNSS sample");

	err = nrf_modem_lib_init();
	if (err) {
		LOG_ERR("Modem library initialization failed, error: %d", err);
		return err;
	}
	if (gnss_init_and_start() != 0) {
		LOG_ERR("Failed to initialize and start GNSS");
		return -1;
	}
	fix_timestamp = k_uptime_get();

	for (;;) 
	{
		(void)k_poll(events, 2, K_FOREVER);
        LOG_INF("gets here 238");
		if (events[0].state == K_POLL_STATE_SEM_AVAILABLE && k_sem_take(events[0].sem, K_NO_WAIT) == 0) 
		{
				/* PVT and NMEA output mode. */
				LOG_INF("\033[1;1H");
				LOG_INF("\033[2J");
				print_satellite_stats(&last_pvt);

				if (last_pvt.flags & NRF_MODEM_GNSS_PVT_FLAG_DEADLINE_MISSED) 
				{
					LOG_INF("GNSS operation blocked by LTE\n");
				}
				if (last_pvt.flags & NRF_MODEM_GNSS_PVT_FLAG_NOT_ENOUGH_WINDOW_TIME) 
				{
					LOG_INF("Insufficient GNSS time windows\n");
				}
				if (last_pvt.flags & NRF_MODEM_GNSS_PVT_FLAG_SLEEP_BETWEEN_PVT) 
				{
					LOG_INF("Sleep period(s) between PVT notifications\n");
				}
				//LOG_INF("gets here 258");
				LOG_INF("-----------------------------------\n");

				if (last_pvt.flags & NRF_MODEM_GNSS_PVT_FLAG_FIX_VALID) 
				{
					LOG_WRN("gets here 260");
					fix_timestamp = k_uptime_get();
					//LOG_INF("gets here 266");
					print_fix_data(&last_pvt);
					//LOG_INF("gets here 266");
					print_distance_from_reference(&last_pvt);

					LOG_WRN("gets here 266");
					k_mutex_lock(&last_pvt_mutex, K_FOREVER);
					zbus_chan_pub(&acc_data_channel, &last_pvt, K_SECONDS(1));
					k_mutex_unlock(&last_pvt_mutex);
					LOG_WRN("gets here 270");
				} 
				else 
				{
					//LOG_INF("gets here 261");
					LOG_INF("Seconds since last fix: %d\n",
							(uint32_t)((k_uptime_get() - fix_timestamp) / 1000));
					cnt++;
					LOG_INF("Searching [%c]\n", update_indicator[cnt%4]);
				}
		}
	}
	return 0;
}
```
